## tools/aosp-device-port/device/aether/arm64/kernel/aether_gki_defconfig
```kconfig
# aether_gki_defconfig — AETHER kernel configuration.
#
# Mirrors hypervisor/src/kernel_defconfig.rs::AETHER_GKI_DEFCONFIG (48 entries)
# Mirrors hypervisor/src/adreno_render.rs::ADRENO_RENDER_DEFCONFIG  (13 entries)
#
# Layered on top of arch/arm64/configs/gki_defconfig from GKI 6.1.
# Drift verification: tools/aosp-device-port/scripts/check-drift.sh

# ── Filesystems (AETHER_GKI_DEFCONFIG) ──────────────────────────────────────
CONFIG_TMPFS=y
CONFIG_TMPFS_POSIX_ACL=y
CONFIG_TMPFS_XATTR=y
CONFIG_DEVTMPFS=y
CONFIG_DEVTMPFS_MOUNT=y
CONFIG_PROC_FS=y
CONFIG_PROC_PID_CPUSET=y
CONFIG_SYSFS=y
CONFIG_EXT4_FS_SECURITY=y
CONFIG_EXT4_FS_XATTR=y
CONFIG_F2FS_FS_XATTR=y
CONFIG_F2FS_FS_SECURITY=y
CONFIG_F2FS_FS_POSIX_ACL=y

# ── Networking ──────────────────────────────────────────────────────────────
CONFIG_NET=y
CONFIG_INET=y
CONFIG_IPV6=y
CONFIG_UNIX=y
CONFIG_PACKET=y
CONFIG_NETFILTER=y
CONFIG_NETFILTER_XTABLES=y
CONFIG_IP_NF_IPTABLES=y
CONFIG_IP_NF_FILTER=y
CONFIG_NET_NS=y
CONFIG_ANDROID_PARANOID_NETWORK=y

# ── IPC and synchronisation ─────────────────────────────────────────────────
CONFIG_ANDROID_BINDERFS=y
CONFIG_POSIX_MQUEUE=y
CONFIG_FUTEX=y
CONFIG_EPOLL=y
CONFIG_SIGNALFD=y
CONFIG_TIMERFD=y
CONFIG_EVENTFD=y
CONFIG_FHANDLE=y

# ── Namespaces and isolation ────────────────────────────────────────────────
CONFIG_NAMESPACES=y
CONFIG_PID_NS=y
CONFIG_UTS_NS=y
CONFIG_IPC_NS=y
CONFIG_USER_NS=y
CONFIG_CHECKPOINT_RESTORE=y
CONFIG_CROSS_MEMORY_ATTACH=y

# ── cgroups ─────────────────────────────────────────────────────────────────
CONFIG_CGROUP_DEVICE=y
CONFIG_CGROUP_SCHED=y
CONFIG_CPUSETS=y
CONFIG_MEMCG=y
CONFIG_MEMCG_SWAP=y
CONFIG_PSI=y

# ── Security ────────────────────────────────────────────────────────────────
CONFIG_SECCOMP=y
CONFIG_SECCOMP_FILTER=y
CONFIG_KEYS=y
CONFIG_PERSISTENT_KEYRINGS=y
CONFIG_RANDOMIZE_BASE=y
CONFIG_STACKPROTECTOR_STRONG=y
CONFIG_HARDENED_USERCOPY=y
CONFIG_STRICT_KERNEL_RWX=y
CONFIG_STRICT_MODULE_RWX=y

# ── Block and storage ───────────────────────────────────────────────────────
CONFIG_BLK_DEV_DM=y
CONFIG_DM_CRYPT=y
CONFIG_CRYPTO_AES=y
CONFIG_CRYPTO_XTS=y
CONFIG_CRYPTO_SHA256=y
CONFIG_NVME_MULTIPATH=y
CONFIG_BLK_WBT=y

# ── HID / USB / Input ───────────────────────────────────────────────────────
CONFIG_HID=y
CONFIG_HID_GENERIC=y
CONFIG_HID_MULTITOUCH=y
CONFIG_INPUT=y
CONFIG_INPUT_EVDEV=y

# ── Crypto for Android Keystore ─────────────────────────────────────────────
CONFIG_CRYPTO_GCM=y
CONFIG_CRYPTO_HMAC=y
CONFIG_CRYPTO_RSA=y
CONFIG_CRYPTO=y

# ── DRM core (ADRENO_RENDER_DEFCONFIG row 0–1) ──────────────────────────────
CONFIG_DRM=y
CONFIG_DRM_KMS_HELPER=y

# ── Adreno MSM DRM driver (ADRENO_RENDER_DEFCONFIG row 2) ───────────────────
CONFIG_DRM_MSM=m

# ── Sync fences + DMA-BUF heaps (ADRENO_RENDER_DEFCONFIG rows 3–6) ──────────
CONFIG_SYNC_FILE=y
CONFIG_DMA_SHARED_BUFFER=y
CONFIG_DMABUF_HEAPS=y
CONFIG_DMABUF_HEAPS_SYSTEM=y

# ── Display connector (ADRENO_RENDER_DEFCONFIG row 7) ───────────────────────
CONFIG_DRM_DISPLAY_CONNECTOR=y

# ── Media support for hw video decode (ADRENO_RENDER_DEFCONFIG rows 8–10) ───
CONFIG_MEDIA_SUPPORT=y
CONFIG_VIDEO_DEV=y
CONFIG_MEDIA_CONTROLLER=y

# ── Diagnostics / pstore ────────────────────────────────────────────────────
CONFIG_IKCONFIG=y
CONFIG_IKCONFIG_PROC=y
CONFIG_PRINTK=y
CONFIG_EARLY_PRINTK=y
CONFIG_PSTORE=y
CONFIG_PSTORE_RAM=y
CONFIG_PSTORE_CONSOLE=y
CONFIG_PERF_EVENTS=y
CONFIG_HW_PERF_EVENTS=y

# ── Explicitly disabled ─────────────────────────────────────────────────────
# AETHER_GKI_DEFCONFIG forbidden entries.
# CONFIG_VT is not set
# CONFIG_MAGIC_SYSRQ is not set
# CONFIG_MODULE_SIG_FORCE is not set
# CONFIG_ANDROID_LOW_MEMORY_KILLER is not set
# CONFIG_CPU_BIG_ENDIAN is not set
# CONFIG_FB is not set
```
